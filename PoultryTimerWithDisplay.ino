#include <Wire.h>
#include <Adafruit_GFX.h>
#include <Adafruit_SSD1306.h>
#include <RTClib.h>
#include <SPI.h>

#define SCREEN_WIDTH 128
#define SCREEN_HEIGHT 64
#define OLED_RESET -1
Adafruit_SSD1306 display(SCREEN_WIDTH, SCREEN_HEIGHT, &Wire, OLED_RESET);

RTC_DS3231 rtc;
const int relay1 = 6;
const int relay2 = 5;
const int in1 = 8;
const int in2 = 9;

void actuatorPull();
void actuatorPush();
void turnOFF();
int counter = 0;

int buttonPinUp = 2;    // Button for increasing hours/minutes
int buttonPinDown = 3;  // Button for decreasing hours/minutes
int buttonPinMode = 4;  // Button for switching between adjusting hours and minutes
int buttonStateUp = 0;
int buttonStateDown = 0;
int buttonStateMode = 0;

const unsigned char epd_bitmap_poultrypicture [] PROGMEM = {
	0x00, 0x00, 0x00, 0x00, 0x00, 0x00, 0x00, 0x00, 0x00, 0x00, 0x00, 0x00, 0x00, 0x00, 0x00, 0x00, 
	0x00, 0x00, 0x00, 0x00, 0x00, 0x00, 0x00, 0x00, 0x07, 0xfe, 0x00, 0x00, 0x00, 0x00, 0x00, 0x00, 
	0x00, 0x00, 0x00, 0x00, 0x00, 0x00, 0x00, 0x00, 0x0f, 0xff, 0x80, 0x00, 0x00, 0x00, 0x00, 0x00, 
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	0x00, 0x00, 0x00, 0x00, 0x80, 0xe0, 0x00, 0x00, 0x00, 0x00, 0x00, 0x00, 0x00, 0x00, 0x00, 0x00
};

DateTime now;
bool adjustMinutesMode = true;  // Initially start with adjusting minutes

void setup() {
  Serial.begin(9600);
  display.begin(SSD1306_SWITCHCAPVCC, 0x3C);  // Address 0x3C for the OLED display
  display.clearDisplay();

  pinMode(buttonPinUp, INPUT_PULLUP);
  pinMode(buttonPinDown, INPUT_PULLUP);
  pinMode(buttonPinMode, INPUT_PULLUP);
  pinMode(relay1, OUTPUT);  // set pin as output for relay 1
  pinMode(relay2, OUTPUT);  // set pin as output for relay 2
  pinMode(in1, INPUT_PULLUP);
  pinMode(in2, INPUT_PULLUP);
  digitalWrite(relay1, HIGH);
  digitalWrite(relay2, HIGH);

  if (!rtc.begin()) {
    Serial.println("Couldn't find RTC");
    while (1)
      ;
  }

  if (rtc.lostPower()) {
    Serial.println("RTC lost power, setting time...");
    rtc.adjust(DateTime(F(__DATE__), F(__TIME__)));
  }
  display.clearDisplay();
  display.drawBitmap(0, 0, epd_bitmap_poultrypicture, 128, 64, WHITE);
  display.display();
  delay(5000);
}

void loop() {
  buttonStateUp = digitalRead(buttonPinUp);
  buttonStateDown = digitalRead(buttonPinDown);
  buttonStateMode = digitalRead(buttonPinMode);

  now = rtc.now();
  int currentHour = now.hour();
  int currentMinute = now.minute();
  int currentSecond = now.second();
  // Serial.print(currentHour);
  // Serial.print(":");
  // Serial.print(currentMinute);
  // Serial.print(" currentcount:");
  // Serial.println(counter);
  // && (currentSecond == 0)
  // bypass feature to turn on and off the actuator whenever required
  if (digitalRead(in1) == LOW) {
    actuatorPush();
  } else if (digitalRead(in2) == LOW) {
    actuatorPull();
  } else {
    turnOFF();
  }

  display.clearDisplay();
  display.setTextSize(2);
  display.setTextColor(SSD1306_WHITE);
  display.setCursor(10, 10);
  display.print("Count: ");
  display.print(counter);
  display.setTextSize(3);
  display.setCursor(20, 40);
  display.print(now.hour(), DEC);
  display.print(":");
  if (now.minute() < 10) {
    display.print("0");
  }
  display.print(now.minute(), DEC);
  display.display();

  if (buttonStateMode == LOW) {
    adjustMinutesMode = !adjustMinutesMode;  // Toggle the mode between adjusting minutes and hours
    delay(200);                              // Debounce the button
  }

  if (buttonStateUp == LOW) {
    adjustTime(1);  // Increase hours/minutes
  }

  if (buttonStateDown == LOW) {
    adjustTime(-1);  // Decrease hours/minutes
  }
  if ((currentHour >= 9 && currentHour < 13) || currentHour == 16) {
    if ((currentMinute % 10 == 0)) {
      counter++;
      actuatorPush();
      delay(30000);    // pushes the actuator for 30 seconds
      actuatorPull();  // pulls back the actuator after 30 seconds
      delay(30000);
      turnOFF();  //turns off the actuator after 30 seconds to save power
      delay(100);
    }
  }

  delay(100);
}

void adjustTime(int amount) {
  DateTime adjustedTime = rtc.now();
  if (adjustMinutesMode) {
    int newMinutes = adjustedTime.minute() + amount;

    if (newMinutes < 0) {
      newMinutes = 59;
      adjustedTime = adjustedTime - TimeSpan(0, 1, 0, 0);
    } else if (newMinutes > 59) {
      newMinutes = 0;
      adjustedTime = adjustedTime + TimeSpan(0, 1, 0, 0);
    }

    adjustedTime = DateTime(adjustedTime.year(), adjustedTime.month(), adjustedTime.day(),
                            adjustedTime.hour(), newMinutes, adjustedTime.second());
  } else {
    int newHours = adjustedTime.hour() + amount;

    if (newHours < 0) {
      newHours = 23;
      adjustedTime = adjustedTime - TimeSpan(1, 0, 0, 0);
    } else if (newHours > 23) {
      newHours = 0;
      adjustedTime = adjustedTime + TimeSpan(1, 0, 0, 0);
    }

    adjustedTime = DateTime(adjustedTime.year(), adjustedTime.month(), adjustedTime.day(),
                            newHours, adjustedTime.minute(), adjustedTime.second());
  }

  rtc.adjust(adjustedTime);
}
void actuatorPush() {
  digitalWrite(relay1, LOW);   // turn relay 1 ON
  digitalWrite(relay2, HIGH);  // turn relay 2 OFF
}

void actuatorPull() {
  digitalWrite(relay1, HIGH);  // turn relay 1 OFF
  digitalWrite(relay2, LOW);   // turn relay 2 ON
}
void turnOFF() {
  digitalWrite(relay1, HIGH);  // turn relay 1 OFF
  digitalWrite(relay2, HIGH);  // turn relay 2 OFF
}
